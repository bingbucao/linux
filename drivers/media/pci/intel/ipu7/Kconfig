## drivers/media/pci/intel/ipu7/Kconfig
```kconfig
config VIDEO_INTEL_IPU7
	tristate "Intel IPU7 driver"
	depends on ACPI || COMPILE_TEST
	depends on VIDEO_DEV
	depends on X86 && HAS_DMA
	select DMA_OPS
	select IOMMU_IOVA
	select VIDEO_V4L2_SUBDEV_API
	select MEDIA_CONTROLLER
	select VIDEOBUF2_DMA_CONTIG
	select V4L2_FWNODE
	select IPU_BRIDGE
	help
	  This is the 7th Gen Intel Image Processing Unit, found in Intel SoCs
	  and used for capturing images and video from camera sensors.
```
